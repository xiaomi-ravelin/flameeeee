// SPDX-License-Identifier: BSD-3-Clause

/dts-v1/;
/plugin/;

#include "ravelin-audio-xiaomi-flame-common.dtsi"

/ {
	model = "Qualcomm Technologies, Inc. Flame QRD";
	compatible = "qcom,ravelin-qrd", "qcom,ravelin", "qcom,qrd";
	qcom,msm-id = <581 0x10000>, <568 0x10000>, <582 0x10000>, <602 0x10000>,
		<653 0x10000>, <654 0x10000>;
	qcom,board-id = <0x2000B 0x00>, <0x2000B 0x600>;
};
